VERSION ""

NS_ :

BS_:

BU_:

BO_ 2147484577 State_Car2: 5 Vector__XXX
 SG_ Position_Car2 : 16|32@1+ (1,0) [0|0] "" Vector__XXX
 SG_ Lane_Car2 : 0|2@1+ (1,0) [0|0] "" Vector__XXX

BO_ 2147484576 State_Car1: 5 Vector__XXX
 SG_ Position_Car1 : 16|32@1+ (1,0) [0|0] "" Vector__XXX
 SG_ Lane_Car1 : 0|2@1+ (1,0) [0|0] "" Vector__XXX

EV_ CTRL_LaneCar2_3: 0 [0|0] "" 0 1 DUMMY_NODE_VECTOR0 Vector__XXX;

EV_ CTRL_LaneCar2_2: 0 [0|0] "" 0 2 DUMMY_NODE_VECTOR0 Vector__XXX;

EV_ CTRL_LaneCar2_1: 0 [0|0] "" 0 3 DUMMY_NODE_VECTOR0 Vector__XXX;

EV_ CTRL_LaneCar2_0: 0 [0|0] "" 0 4 DUMMY_NODE_VECTOR0 Vector__XXX;

EV_ CTRL_LaneCar1_3: 0 [0|0] "" 0 5 DUMMY_NODE_VECTOR0 Vector__XXX;

EV_ CTRL_LaneCar1_2: 0 [0|0] "" 0 6 DUMMY_NODE_VECTOR0 Vector__XXX;

EV_ CTRL_LaneCar1_1: 0 [0|0] "" 0 7 DUMMY_NODE_VECTOR0 Vector__XXX;

EV_ CTRL_LaneCar1_0: 0 [0|0] "" 0 8 DUMMY_NODE_VECTOR0 Vector__XXX;

EV_ CTRL_Signal_Car2: 0 [0|0] "" 0 9 DUMMY_NODE_VECTOR0 Vector__XXX;

EV_ CTRL_Signal_Car1: 0 [0|0] "" 0 10 DUMMY_NODE_VECTOR0 Vector__XXX;

EV_ CTRL_DistanceCar2_3b: 0 [0|0] "" 0 11 DUMMY_NODE_VECTOR0 Vector__XXX;

EV_ CTRL_DistanceCar2_3a: 0 [0|0] "" 0 12 DUMMY_NODE_VECTOR0 Vector__XXX;

EV_ CTRL_DistanceCar2_2b: 0 [0|0] "" 0 13 DUMMY_NODE_VECTOR0 Vector__XXX;

EV_ CTRL_DistanceCar2_2a: 0 [0|0] "" 0 14 DUMMY_NODE_VECTOR0 Vector__XXX;

EV_ CTRL_DistanceCar2_1b: 0 [0|0] "" 0 15 DUMMY_NODE_VECTOR0 Vector__XXX;

EV_ CTRL_DistanceCar2_1a: 0 [0|0] "" 0 16 DUMMY_NODE_VECTOR0 Vector__XXX;

EV_ CTRL_DistanceCar2_0b: 0 [0|0] "" 0 17 DUMMY_NODE_VECTOR0 Vector__XXX;

EV_ CTRL_DistanceCar2_0a: 0 [0|0] "" 0 18 DUMMY_NODE_VECTOR0 Vector__XXX;

EV_ CTRL_DistanceCar2: 0 [0|0] "" 0 19 DUMMY_NODE_VECTOR0 Vector__XXX;

EV_ CTRL_DistanceCar1_3b: 0 [0|0] "" 0 20 DUMMY_NODE_VECTOR0 Vector__XXX;

EV_ CTRL_DistanceCar1_3a: 0 [0|0] "" 0 21 DUMMY_NODE_VECTOR0 Vector__XXX;

EV_ CTRL_DistanceCar1_2b: 0 [0|0] "" 0 22 DUMMY_NODE_VECTOR0 Vector__XXX;

EV_ CTRL_DistanceCar1_2a: 0 [0|0] "" 0 23 DUMMY_NODE_VECTOR0 Vector__XXX;

EV_ CTRL_DistanceCar1_1b: 0 [0|0] "" 0 24 DUMMY_NODE_VECTOR0 Vector__XXX;

EV_ CTRL_DistanceCar1_1a: 0 [0|0] "" 0 25 DUMMY_NODE_VECTOR0 Vector__XXX;

EV_ CTRL_DistanceCar1_0b: 0 [0|0] "" 0 26 DUMMY_NODE_VECTOR0 Vector__XXX;

EV_ CTRL_DistanceCar1_0a: 0 [0|0] "" 0 27 DUMMY_NODE_VECTOR0 Vector__XXX;

EV_ CTRL_DistanceCar1: 0 [0|0] "" 0 28 DUMMY_NODE_VECTOR0 Vector__XXX;
