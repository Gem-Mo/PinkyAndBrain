variables
{
    // ACC settings
	byte speed_adjusted;	        // ACC configured speed (in km/h)
	byte distance_adjusted;			// ACC configured distance (in 1/10 seconds)
	byte acc = 0;
	
	// Messages
	message Distance_Adjust distance;
	message Speed_Adjust speed;
	message ACC_State acc_state;
	message Manual_Accelerate manual_accelerate;
	message Manual_Brake manual_brake;
	message Lane_Change lane_change;
  
  int  speed_current;
  int prev_acc_state = 0;
  
  
	message ACC_Accelerate acc_accelerate;

	// On every change of an environment variable (e.g. on the push of a button)
	// an according message will be published on the bus
}

on start {
  @DUI_Speed_Adjusted = 0;
}

// Update with current ACC settings

on message Display_State
{
	speed_adjusted = this.Speed_Adjusted;
	distance_adjusted = this.Distance_Adjusted;
	acc = this.ACC_State;
}

// Change of ACC state, ACC on/off

on envVar CUI_ACC_State
{
	if (getValue(CUI_ACC_State) == 1) 
    {
		if (acc) 
        {
			acc = 0;
		}
		else 
        {
			acc = 1;
		}

		acc_state.ACC_State = acc;

		output(acc_state);
	}
}

on message Car1_State {
  speed_current = this.Speed_Car1_Current;
  if (speed_current <= 25 && acc == 1){
    @CUI_ACC_State = 0; 
    acc_state.ACC_State = 0;
    prev_acc_state = 1;
  } else if (speed_current > 25 && prev_acc_state == 1) {
    @CUI_ACC_State = 1; 
    acc_state.ACC_State = 1;
    prev_acc_state = 0;
  }
  sendACCState();
  //&& speed_adjusted <= 180
  if (speed_adjusted >= 30) {
    @CUI_Speed_Plus;
    
    speed.Speed_Adjust = speed_adjusted;
    sendSpeedAdjusted();
  }
  
  
  if (distance_adjusted <= 30 && distance_adjusted >= 10){
    distance.Distance_Adjust = distance_adjusted;
    sendDistanceAdjusted();
   }
}


on message Speed_Adjust {
  
}


// Lower ACC configured distance

on envVar CUI_Distance_Minus
{
	if (getValue(CUI_Distance_Minus) == 1 && distance_adjusted <= 10000)
    {
		distance.Distance_Adjust = distance_adjusted - 1;

		output(distance);
	}
}

// Raise ACC configured distance

on envVar CUI_Distance_Plus
{
	if (getValue(CUI_Distance_Plus) == 1) 
    {
		distance.Distance_Adjust = distance_adjusted + 1;

		output(distance);
	}
}

// Manual breaking

on envVar CUI_Brake
{
	if (getValue(CUI_Brake) == 1) 
    {
		manual_brake.PedalTravel_Manual_Brake = 40;

		output(manual_brake);
	}
}

// Manual acceleration

on envVar CUI_Accelerate
{
	if (getValue(CUI_Accelerate) == 1) 
    {
		manual_accelerate.PedalTravel_Manual_Accelerate = 40;

		output(manual_accelerate);
	}
}

// Lower ACC configured speed

on envVar CUI_Speed_Minus
{
	if (getValue(CUI_Speed_Minus) == 1) 
    {
		speed.Speed_Adjust = speed_adjusted - 5;

		output(speed);
	}
}

// Raise ACC configured speed


on envVar CUI_Speed_Plus
{
	if (getValue(CUI_Speed_Plus) == 1 && acc == 1) 
    {
    //if (speed_adjusted >= 30 && speed_adjusted <= 175) {
		speed.Speed_Adjust = speed_adjusted + 5;
    @DUI_Speed_Adjusted = speed_adjusted + 5;
		output(speed);
    sendACCAccelerate();
    //}
	}
 
}

// Change lane to the left

on envVar CUI_Lane_Left
{
	if (getValue(CUI_Lane_Left) == 1) 
    {
		lane_change.Lane_Change_Direction = 1;

		output(lane_change);
	}
}

// Change lane to the right

on envVar CUI_Lane_Right
{
	if (getValue(CUI_Lane_Right) == 1) 
    {
		lane_change.Lane_Change_Direction = 0;

		output(lane_change);
	}
}

sendACCAccelerate() {  
  acc_accelerate.PedalTravel_ACC_Accelerate = 1;
    output(acc_accelerate);  
}

sendACCState (){
 //acc_state.ACC_State = acc;
 output(acc_state);
}

sendSpeedAdjusted(){
  
 output(speed);
}

sendDistanceAdjusted(){
  
  output(distance);
}