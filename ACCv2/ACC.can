includes
{

}
variables
{
  byte distance_adjusted;			// ACC configured distance (in 1/10 seconds)
  message Distance_Adjust distance;
  message Display_State display_state;
}
on message Distance_Adjust {
  display_state.Distance_Adjusted = this.Distance_Adjust;
  
   // putValue(DUI_Distance_Adjusted, distance_adjusted);    
  sendDisplayState();
}

on message ACC_State {
  display_state.ACC_State = this.ACC_State;
  sendDisplayState();
}

on message Speed_Adjust {
  display_state.Speed_Adjusted = this.Speed_Adjust;
  sendDisplayState();
}

sendDisplayState(){
  //(DUI_Distance_Adjusted, distance_adjusted);
  //TODO:
  // display_state.ACC_State = x; 
  // display_state.Distance_Adjusted = x;
  // display_state.Speed_Adjusted = x;
output(display_state);  
}
