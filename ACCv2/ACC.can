/*@!Encoding:1252*/includes {

}

variables {
  byte distance; // ACC configured distance (in 1/10 seconds)
  byte speed;
  long distance_curr;
  byte lane_car1_current;
  byte speed_car1_current;
  byte lane_car2_current;
  byte speed_car2_current;
  byte position_car1;
  byte acc_err;
  byte acc;
  float distance_s;
  int counter = 0;

  message Distance_Adjust distance_adjust;
  message Distance_Current distance_current;
  message Speed_Adjust speed_adjust;
  message Display_State display_state;
  message Car1_State car1_state;
  message ACC_Error acc_error;
  message ACC_Accelerate acc_accelerate;
  message ACC_Brake acc_brake;
  message ACC_Slowdown acc_slowdown;
}

on start {
  sendSettings();
}

on message ACC_State {
  if (speed_car1_current > 25 && speed_car1_current < 180) {
    acc = this.ACC_State;
    if (acc == 1) {
      speed = 80;
      distance = 20;
    }

    sendSettings();
  }
}

on message Car1_State {
  lane_car1_current = this.Lane_Car1_Current;
  speed_car1_current = this.Speed_Car1_Current;
  position_car1 = this.Position_Car1;

  if (speed_car1_current < 25 && display_state.ACC_State == 1) {
    display_state.ACC_State = 0;
    acc_err = 1;
    acc_error.ACC_Error = acc_err;
    output(acc_error);
  }
  sendSettings();
}

on message Car2_State {
  speed_car2_current = this.Speed_Car2_Current;
  lane_car2_current = this.Lane_Car2_Current;
}

on message Distance_Adjust {
  if (acc == 1) {
    if (this.Distance_Adjust >= 10 && this.Distance_Adjust <= 30) {
      distance = this.Distance_Adjust;
    }
  }
}

on message Speed_Adjust {
  if (acc == 1) {
    if (this.Speed_Adjust >= 30 && this.Speed_Adjust <= 180) {
      speed = this.Speed_Adjust;
    }
  }
}

on message Distance_Current {
  distance_curr = this.Distance_Current;
  distance_s = ((distance_curr / 100) / ((float) speed_car1_current / 3.6))*10; // conversion of distance_curr from cm to meter and 
                                                                                // convertion of speed_car1_current from km/h to m/s
  if (acc == 1) {
   
    // Counter, damit Tacho Zeiger sich nicht zu schnell bewegt
    counter++;
    if ((counter % 10) != 0)
  {
    return;
  }
    // Zu nah am Vordermann
    if (distance_s <= ((double) distance)) {
      // Selbe Spur
      if (lane_car1_current == lane_car2_current) {
        // Näher als kritische Distanz von 0,7s
        if (distance_s <= 7) {
          sendACCBrake();
        } else {
          sendACCSlowdown();
        }
      }
    } 
    // Schneller als ACC
    else if (speed_car1_current > speed) {     
      sendACCSlowdown();
    } 
    // Langsamer als ACC
    else if (speed_car1_current < speed) {
      sendACCAccelerate();
    }
  }
}

on message Manual_Accelerate {
  acc = 0;
  sendSettings();
}

on message Manual_Brake {
  acc = 0;
  sendSettings();
}

sendACCAccelerate() {
  acc_accelerate.PedalTravel_ACC_Accelerate = 1;
  output(acc_accelerate);
}

sendACCBrake() {
  acc_brake.PedalTravel_ACC_Brake = 1;
  output(acc_brake);
}

sendACCSlowdown() {
  acc_slowdown.PedalTravel_ACC_Slowdown = 1;
  output(acc_slowdown);
}

sendSettings() {
  display_state.ACC_State = acc;
  display_state.Speed_Adjusted = speed;
  display_state.Distance_Adjusted = distance;

  output(display_state);
}